# cyw20829 register map
Vendor: Infineon Technologies; Series: CYW20829; File version: 1.0
CPU: CM33 r0p1, little endian, MPU, no FPU, VTOR, 3 interrupt priority bits
Registers are 32-bit, read-write, reset 0x0 unless marked. A register's access mark holds for its fields unless they carry their own. Offsets are from the block's base; lines under a group give offsets from that group; [hi:lo] are bit positions; {n}, {i} and the like mark numbered series; 'fields as' and 'values as' point back to an identical list; <NAME> marks a mode.

## Memory map
0x40000000 PERI size 0x10000 — Peripheral interconnect
0x40020000 PPC size 0x10000 — Peripheral Protection Controller
0x40040000 PERI_PCLK size 0x20000 — Peripheral PCLK groups
0x40100000 RAMC_PPU0 size 0x1000 — Power Policy Unit Registers for System RAM
0x40101000 RAMC_PPU1 size 0x1000
0x40102000 RAMC_PPU2 size 0x1000
0x40103000 ICACHE0 size 0x1000 — CM33_0/1 CA APB interface
0x40104000 ICACHE1 size 0x1000
0x40105000 CPUSS_PPU size 0x1000 — Power Policy Unit Registers for CPUSS
0x40110000 RAMC0 size 0x10000 — RAMC0/1/2
0x40140000 PROMC size 0x10000 — Patchable ROM Controller
0x40160000 MXCM33 size 0x10000 — MXCM33-0/1
0x40180000 DW0 size 0x10000 — DW-0/1
0x401C0000 CPUSS size 0x4000 — SYSCPUSS registers
0x401C4000 MS_CTL_1_2 size 0x4000 — Master control registers
0x401C8000 CPUSS_SL_CTL size 0x10 — SYSCPUSS Internal slave control registers
0x401D0000 IPC size 0x10000
0x40200000 SRSS size 0x10000 — SRSS Core Registers
0x40210000 PWRMODE size 0x10000 — SRSS Power Mode Control Registers
0x40220000 BACKUP size 0x10000 — SRSS Backup Registers
0x40230000 CRYPTOLITE size 0x10000
0x40400000 HSIOM size 0x4000 — IO Matrix (IOM)
0x40410000 GPIO size 0x10000 — IO port control/configuration
0x40420000 SMARTIO size 0x10000 — Programmable IO configuration
0x40430000 LIN0 size 0x10000 — LIN
0x40440000 CANFD0 size 0x20000 — CAN Controller
0x404A0000 TCPWM0 size 0x20000 — Timer/Counter/PWM
0x40520000 MXS40ADCMIC0 size 0x10000 — ADC
0x40590000 SCB0 size 0x10000 — Serial Communications Block (SPI/UART/I2C)
0x405A0000 SCB1 size 0x10000
0x405B0000 SCB2 size 0x10000
0x40810000 EFUSE size 0x200 — EFUSE MXS40 registers
0x40890000 SMIF0 size 0x10000 — Serial Memory Interface
0x408C0000 TDM0 size 0x10000 — TDM
0x408D0000 PDM0 size 0x10000 — PDM
0x40920000 MXKEYSCAN size 0x1000 — 0
0x42000000 BTSS size 0x1000000 — MXS40BLE52SS IP

## Interrupts
0 ioss_interrupts_gpio_0 (CPUSS) — GPIO Port Interrupt #0
1 ioss_interrupts_gpio_1 (CPUSS) — GPIO Port Interrupt #1
2 ioss_interrupts_gpio_2 (CPUSS) — GPIO Port Interrupt #2
3 ioss_interrupts_gpio_3 (CPUSS) — GPIO Port Interrupt #3
4 ioss_interrupts_gpio_4 (CPUSS) — GPIO Port Interrupt #4
5 ioss_interrupts_gpio_5 (CPUSS) — GPIO Port Interrupt #5
6 ioss_interrupt_vdd (CPUSS) — GPIO Supply Detect Interrupt
7 ioss_interrupt_gpio (CPUSS) — GPIO All Ports
8 scb_0_interrupt (CPUSS) — Serial Communication Block #0 (DeepSleep capable)
9 srss_interrupt_mcwdt_0 (CPUSS) — Multi Counter Watchdog Timer interrupt
10 srss_interrupt_backup (CPUSS) — Backup domain interrupt
11 srss_interrupt (CPUSS) — Other combined Interrupts for srss (LVD and CLKCAL, CLKCAL only supported in Active mode)
12 cpuss_interrupts_ipc_dpslp_0 (CPUSS) — cpuss Inter Process Communication Interrupt #0
13 cpuss_interrupts_ipc_dpslp_1 (CPUSS) — cpuss Inter Process Communication Interrupt #1
14 keyscan_interrupt (CPUSS) — mxkeyscan interrupt for keyscan edge or fifo thresh to WIC in M33
15 srss_interrupt_wdt (CPUSS) — Interrupt from WDT
16 btss_interrupt_btss_ipc (CPUSS) — interrupt from BTSS IPC
17 scb_1_interrupt (CPUSS) — Serial Communication Block #1
18 scb_2_interrupt (CPUSS) — Serial Communication Block #2
{n+19} cpuss_interrupts_dw0_{n} (CPUSS) (n=0..15) — cpuss DataWire #0, Channel #{n}
35 cpuss_interrupt_mpc_promc (CPUSS) — PROMC Int
36 cpuss_interrupt_ppu_sramc0 (CPUSS) — PPU SRAM0
37 cpuss_interrupt_mpc_sramc0 (CPUSS) — MPC SRAM0
38 cpuss_interrupt_cm33_0_fp (CPUSS) — CM33 0 Floating Point Interrupt
39 cpuss_interrupts_cm33_0_cti_0 (CPUSS) — CM33-0 CTI interrupt outputs
40 cpuss_interrupts_cm33_0_cti_1 (CPUSS) — CM33-1 CTI interrupt outputs
41 cpuss_interrupt_exp_br_ahb_error (CPUSS) — EXPANSION BRIDGE AHB Error interrupt
42 tcpwm_0_interrupts_0 (CPUSS) — TCPWM #0, Counter #0
43 tcpwm_0_interrupts_1 (CPUSS) — TCPWM #0, Counter #1
44 tcpwm_0_interrupts_256 (CPUSS) — TCPWM #0, Counter #256
45 tcpwm_0_interrupts_257 (CPUSS) — TCPWM #0, Counter #257
46 tcpwm_0_interrupts_258 (CPUSS) — TCPWM #0, Counter #258
47 tcpwm_0_interrupts_259 (CPUSS) — TCPWM #0, Counter #259
48 tcpwm_0_interrupts_260 (CPUSS) — TCPWM #0, Counter #260
49 tcpwm_0_interrupts_261 (CPUSS) — TCPWM #0, Counter #261
50 tcpwm_0_interrupts_262 (CPUSS) — TCPWM #0, Counter #262
51 smif_interrupt_normal (CPUSS) — Serial Memory Interface interrupt
52 smif_interrupt_mpc (CPUSS) — Serial Memory Interface interrupt
53 tdm_0_interrupts_rx_0 (CPUSS) — TDM0 Audio interrupt RX
54 tdm_0_interrupts_tx_0 (CPUSS) — TDM0 Audio interrupt TX
55 pdm_0_interrupts_0 (CPUSS) — PDM0/PCM0 Audio interrupt
56 pdm_0_interrupts_1 (CPUSS) — PDM0/PCM0 Audio interrupt
57 srss_interrupt_main_ppu (CPUSS) — SRSS Main PPU Interrupt
58 peri_interrupt_ppc (CPUSS) — PERI PPC Interrupt
59 peri_interrupt_ahb_error (CPUSS) — PERI AHB Interrupt
60 lin_0_interrupts_0 (CPUSS) — LIN Interrupt, Channel #0
61 lin_0_interrupts_1 (CPUSS) — LIN Interrupt, Channel #1
62 crypto_interrupt_error (CPUSS) — Crypto Interrupt
63 cpuss_interrupt_ppu_cpuss (CPUSS) — CPUSS PPU Interrupt
64 canfd_0_interrupts0_0 (CPUSS) — CAN #0, Interrupt #0, Channel #0
65 canfd_0_interrupts1_0 (CPUSS) — CAN #0, Interrupt #1, Channel #0
66 canfd_0_interrupt0 (CPUSS) — Can #0, Consolidated interrupt #0
67 adcmic_interrupt_adcmic (CPUSS) — ADCMIC interrupt
68 btss_interrupt_btss_exception (CPUSS) — interrupt indicating BTSS has encountered exception
69 crypto_interrupt_trng (CPUSS) — Crypto TRNG Interrupt

## Licence text in the file
(c) (2016-2024), Cypress Semiconductor Corporation (an Infineon company) or an affiliate of Cypress Semiconductor Corporation. . SPDX-License-Identifier: Apache-2.0 . Licensed under the Apache License, Version 2.0 (the "License"); you may not use this file except in compliance with the License. You may obtain a copy of the License at http://www.apache.org/licenses/LICENSE-2.0 . Unless required by applicable law or agreed to in writing, software distributed under the License is distributed on an "AS IS" BASIS, WITHOUT WARRANTIES OR CONDITIONS OF ANY KIND, either express or implied. See the License for the specific language governing permissions and limitations under the License.
